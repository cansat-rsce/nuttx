## configs/omnibusf4-pro-v2/Kconfig.old
```kconfig
#
# For a description of the syntax of this configuration file,
# see the file kconfig-language.txt in the NuttX tools repository.
#

if ARCH_BOARD_OMNIBUS_F4_PRO_V2

config PM_ALARM_SEC
	int "PM_STANDBY delay (seconds)"
	default 15
	depends on PM && RTC_ALARM
	---help---
		Number of seconds to wait in PM_STANDBY before going to PM_STANDBY
		mode.

config PM_ALARM_NSEC
	int "PM_STANDBY delay (nanoseconds)"
	default 0
	depends on PM && RTC_ALARM
	---help---
		Number of additional nanoseconds to wait in PM_STANDBY before going
		to PM_STANDBY mode.

config PM_SLEEP_WAKEUP
	bool "PM_SLEEP wake-up alarm"
	default n
	depends on PM && RTC_ALARM
	---help---
		Wake-up of PM_SLEEP mode after a delay and resume normal operation.

config PM_SLEEP_WAKEUP_SEC
	int "PM_SLEEP delay (seconds)"
	default 10
	depends on PM && RTC_ALARM
	---help---
		Number of seconds to wait in PM_SLEEP before going to PM_STANDBY mode.

config PM_SLEEP_WAKEUP_NSEC
	int "PM_SLEEP delay (nanoseconds)"
	default 0
	depends on PM && RTC_ALARM
	---help---
		Number of additional nanoseconds to wait in PM_SLEEP before going to
		PM_STANDBY mode.

endif
```

## configs/omnibusf4-pro-v2/nsh/defconfig
```kconfig
# CONFIG_HOST_LINUX=y

CONFIG_ARCH_BOARD_OMNIBUS_F4_PRO_V2=y
CONFIG_ARCH_BOARD="omnibusf4-pro-v2"

CONFIG_ARCH="arm"
CONFIG_ARCH_CHIP_STM32=y
CONFIG_ARCH_CHIP_STM32F405RG=y
CONFIG_ARCH_FPU=y
CONFIG_ARCH_DMA=y
CONFIG_ARCH_LEDS=n
CONFIG_RAM_SIZE=114688
CONFIG_RAM_START=0x20000000

CONFIG_STM32_FLASH_CONFIG_G=y

CONFIG_ARCH_STACKDUMP=y

CONFIG_STM32_DMA1=y
CONFIG_STM32_DMA2=y
CONFIG_STM32_PWR=y
CONFIG_STM32_SPI1=y
CONFIG_STM32_SPI2=y
CONFIG_STM32_SPI3=y

CONFIG_I2C=y

CONFIG_STM32_USART1=y
CONFIG_USART1_RXBUFSIZE=128
CONFIG_USART1_TXBUFSIZE=128
CONFIG_USART1_SERIAL_CONSOLE=y

# Используется I2C
#CONFIG_STM32_USART3=y
#CONFIG_USART3_RXBUFSIZE=128
#CONFIG_USART3_TXBUFSIZE=128

CONFIG_STM32_USART6=y
CONFIG_USART6_RXBUFSIZE=128
CONFIG_USART6_TXBUFSIZE=128

CONFIG_STM32_JTAG_SW_ENABLE=y

CONFIG_SCHED_WAITPID=y
CONFIG_SCHED_WORKQUEUE=y
CONFIG_SCHED_HPWORK=y
CONFIG_SCHED_HPWORKPRIORITY=224
CONFIG_SCHED_HPWORKPERIOD=100000
CONFIG_SCHED_HPWORKSTACKSIZE=2048

CONFIG_BOARD_INITIALIZE=y
CONFIG_BOARD_INITTHREAD=y
CONFIG_USERLED=y
CONFIG_USERLED_LOWER=y
CONFIG_PREALLOC_MQ_MSGS=4
CONFIG_PREALLOC_TIMERS=4
CONFIG_PREALLOC_WDOGS=16
CONFIG_BOARD_LOOPSPERMSEC=16717
CONFIG_BUILTIN=y
CONFIG_DISABLE_POLL=y
CONFIG_EXAMPLES_NSH_CXXINITIALIZE=y
CONFIG_EXAMPLES_NSH=y
CONFIG_FS_PROCFS=y
CONFIG_HAVE_CXX=y
CONFIG_HAVE_CXXINITIALIZE=y
CONFIG_INTELHEX_BINARY=y
CONFIG_MAX_TASKS=16
CONFIG_MAX_WDOGPARMS=2
CONFIG_MM_REGIONS=2
CONFIG_NFILE_DESCRIPTORS=8
CONFIG_NFILE_STREAMS=8
CONFIG_RAW_BINARY=y
CONFIG_RR_INTERVAL=200
CONFIG_SDCLONE_DISABLE=y
CONFIG_START_DAY=6
CONFIG_START_MONTH=12
CONFIG_START_YEAR=2011
CONFIG_DEV_ZERO=y
CONFIG_MMCSD=y
CONFIG_MMCSD_SPI=y
CONFIG_FS_FAT=y
CONFIG_FAT_LCNAMES=y

CONFIG_NSH_BUILTIN_APPS=y
CONFIG_NSH_FILEIOSIZE=512
CONFIG_NSH_LINELEN=64
CONFIG_NSH_READLINE=y

CONFIG_USER_ENTRYPOINT="nsh_main"

CONFIG_DEBUG_SYMBOLS=y
CONFIG_DEBUG_CUSTOMOPT=y
CONFIG_DEBUG_OPTLEVEL="-Og"
```
